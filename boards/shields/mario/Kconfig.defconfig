## boards/shields/mario/Kconfig.defconfig
```kconfig
if SHIELD_MARIO_RIGHT

config ZMK_KEYBOARD_NAME
	default "Mario"

config ZMK_SPLIT_BLE_ROLE_CENTRAL
	default y

endif

if SHIELD_MARIO_LEFT || SHIELD_MARIO_RIGHT

config ZMK_SPLIT
	default y
	
endif
```

## boards/shields/mario/Kconfig.shield
```kconfig
# Copyright (c) 2024 Yuting Wang
# SPDX-License-Identifier: MIT

config SHIELD_MARIO_LEFT
    def_bool $(shields_list_contains,mario_left)

config SHIELD_MARIO_RIGHT
    def_bool $(shields_list_contains,mario_right)
```
